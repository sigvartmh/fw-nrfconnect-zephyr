/*
 * Common Device Tree source, used for conditionally pulling in features and
 * additions by the build system.
 */

#if defined(CONFIG_IS_SECURE_BOOTLOADER) || defined(CONFIG_SECURE_BOOT)
#include "secureboot.overlay"
#endif

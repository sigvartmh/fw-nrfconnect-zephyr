## CMakeLists.txt
```
cmake_minimum_required(VERSION 3.13.1)

include($ENV{ZEPHYR_BASE}/cmake/app/boilerplate.cmake NO_POLICY_SCOPE)
project(hello_world)
set(BOARD nrf9160_pca10090ns)

target_sources(app PRIVATE src/main.c)
```

## prj.conf
```kconfig
# nothing here
CONFIG_SECURE_PARTITION=y
```

## src/main.c
```c
/*
 * Copyright (c) 2012-2014 Wind River Systems, Inc.
 *
 * SPDX-License-Identifier: Apache-2.0
 */

#include <zephyr.h>
#include <misc/printk.h>

static int metadata __attribute__ ((section (".metadata"))) __attribute__ ((__used__)) = 6;

void main(void)
{
	printk("Hello World! %s\n", CONFIG_BOARD);
}
```

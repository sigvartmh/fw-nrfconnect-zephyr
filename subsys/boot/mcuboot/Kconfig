## subsys/boot/mcuboot/Kconfig
```kconfig
if BOOTLOADER_MCUBOOT

config MCUBOOT_CMAKELISTS_DIR
	string "Path to the directory of the MCUBoot CMakeLists.txt file"
	default "/home/sebo/mcuboot/boot/zephyr/"

endif # BOOTLOADER_MCUBOOT
```

## subsys/bootloader/Kconfig
```kconfig
#
# Copyright (c) 2018 Nordic Semiconductor ASA
#
# SPDX-License-Identifier: Apache-2.0
#
config SECURE_BOOT
	bool "Secure Boot Support"
	select SECURE_BOOT_CRYPTO

if !SECURE_BOOT
source "subsys/bootloader/bl0_crypto/Kconfig"

endif
if SECURE_BOOT
menu "Secure Boot Options."

source "subsys/bootloader/bl0_crypto/Kconfig"
source "subsys/bootloader/c_runtime_setup/Kconfig"

config SB_FLASH_LOCKDOWN
	bool "Lock down flash before jumping to next stage."
	default y

config SB_VALIDATION_METADATA_MAGIC_WORD
	string "Hexadecimal magic word to use as metadata format"
	default "B24EFBA01C59E209"
	help
	  Must be byte sized.

config SB_VALIDATION_METADATA_OFFSET
	int "Offset to store application metadata at."
	default 0
	help
	  Must be either 0 or larger than size of application. If 0 is set,
	  the metadata will be appended directly after the application image,
	  aligned to closest word.

config SB_VALIDATION_PEM_PATH
	string "Absolute path to PEM file used for signing image."
	default ""
	help
	  This value can also be set by exporting an environment variable
	  named 'SB_VALIDATION_PEM_PATH' or passing
	  '-DSB_VALIDATION_PEM_PATH=/path/to/my/pem' when running cmake.
	  If no value is set, a random PEM will be generated and placed 
	  in the build directory.

config SB_SYSTEM_INIT
	bool "Boot with chip specific initialization"
	#select SYSTEM_INIT


config SECURE_BOOT_DEBUG
	bool "Debugging support"

if SECURE_BOOT_DEBUG
choice
	prompt "Debug output selection"
	default SB_DEBUG_PORT_SEGGER_RTT
	config SB_DEBUG_PORT_SEGGER_RTT
		bool "SEGGER RTT debug support"
	config SB_DEBUG_PORT_UART
		bool "UART debug support"
endchoice

endif #SECURE_BOOT_DEBUG

if SB_DEBUG_PORT_SEGGER_RTT

config SB_DEBUG_PORT_SEGGER_RTT_MAX_NUM_UP_BUFFERS
	int "Maximum number of up-buffers"
	default 3

config SB_DEBUG_PORT_SEGGER_RTT_MAX_NUM_DOWN_BUFFERS
	int "Maximum number of down-buffers"
	default 3

config SB_DEBUG_PORT_SEGGER_RTT_BUFFER_SIZE_UP
	int "Size of the buffer for terminal output of target, up to host"
	default 1024

config SB_DEBUG_PORT_SEGGER_RTT_BUFFER_SIZE_DOWN
	int "Size of the buffer for terminal input of target, from host"
	default 16

config SB_DEBUG_PORT_SEGGER_RTT_PRINTF_BUFFER_SIZE
	int "Size of buffer for RTT printf to bulk-send chars via RTT"
	default 64

choice
	prompt "Mode for pre-initialized terminal channel (buffer 0)"
	default SB_DEBUG_PORT_SEGGER_RTT_MODE_NO_BLOCK_SKIP
	config SB_DEBUG_PORT_SEGGER_RTT_MODE_NO_BLOCK_SKIP
		bool "Skip. Do not block, output nothing."

	config SB_DEBUG_PORT_SEGGER_RTT_MODE_NO_BLOCK_TRIM
		bool "Trim: Do not block, output as much as fits."

	config SB_DEBUG_PORT_SEGGER_RTT_MODE_BLOCK_IF_FIFO_FULL
		bool "Block: Wait until there is space in the buffer."
endchoice

config SB_DEBUG_PORT_SEGGER_RTT_MODE
	int
	default 2 if SB_DEBUG_PORT_SEGGER_RTT_MODE_BLOCK_IF_FIFO_FULL
	default 1 if SB_DEBUG_PORT_SEGGER_RTT_MODE_NO_BLOCK_TRIM
	default 0

config SB_DEBUG_PORT_SEGGER_RTT_MEMCPY_USE_BYTELOOP
	bool "Use a simple byte-loop instead of standard memcpy"

endif # SB_DEBUG_PORT_SEGGER_RTT

menu "Public Key hashes"
config SB_PUBLIC_KEY_HASH_SIZE
    int "Public key hash size (bits)"
    default 128 
config SB_NUM_PUBLIC_KEY_HASHES
    int "Number of public key hashes to store"
    default 5
config PUBLIC_KEY_0_HASH
	string "ASCII-hex formatted hash of public key 0."
	default "01223344556677881122334455667788"
config PUBLIC_KEY_1_HASH
	string "ASCII-hex formatted hash of public key 1."
	default "11223344556677881122334455667788"
config PUBLIC_KEY_2_HASH
	string "ASCII-hex formatted hash of public key 2."
	default "21223344556677881122334455667788"
config PUBLIC_KEY_3_HASH
	string "ASCII-hex formatted hash of public key 3."
	default "31223344556677881122334455667788"
config PUBLIC_KEY_4_HASH
	string "ASCII-hex formatted hash of public key 4."
	default "41223344556677881122334455667788"
endmenu

endmenu
endif # SECURE_BOOT
```

## subsys/bootloader/bl0_crypto/Kconfig
```kconfig
#
# Copyright (c) 2018 Nordic Semiconductor ASA
#
# SPDX-License-Identifier: Apache-2.0
#
config SECURE_BOOT_CRYPTO
	bool
	prompt "Secure Boot Crypto library" if ZTEST
	help
	  Only meant to be enabled separately from SECURE_BOOT when testing.

if (SECURE_BOOT_CRYPTO)

config SB_NRF_OBERON
	bool
config SB_NRF_CC310_BL
	bool
config SB_ECDSA
	bool
config SB_RSA
	bool

config SB_SIGNATURE_LEN
	int
	default 64 if SB_ECDSA
	default 256 if SB_RSA

config SB_PUBLIC_KEY_LEN
	int
	default 64 if SB_ECDSA
	default 256 if SB_RSA

config SB_HASH_LEN
	int
	default 32

menu "Secure Boot Crypto Options"

choice SB_CRYPTO_SIG
	prompt "Crypto implementation to use for signature verification of firmware in BL0."
	default SB_CRYPTO_OBERON_ECDSA_SECP256R1

	config SB_CRYPTO_OBERON_ECDSA_SECP256R1
		bool "Software implementation of ECDSA with NIST curve secp256r1."
		select SB_NRF_OBERON
		select SB_ECDSA

	config SB_CRYPTO_OBERON_RSA_2048
		bool "Software implementation of RSASSA-PSS, 2048 bits"
		select SB_NRF_OBERON
		select SB_RSA

	config SB_CRYPTO_CC310_ECDSA_SECP256R1
		bool "Hardware implementation of ECDSA with NIST curve secp256r1." if HAS_HW_NRF_CC310
		select SB_NRF_CC310_BL
		select SB_ECDSA

	config SB_CRYPTO_CC310_RSA_2048
		bool "Hardware implementation of RSASSA-PSS, 2048 bits" if HAS_HW_NRF_CC310
		select SB_NRF_CC310_BL
		select SB_RSA
endchoice

choice SB_CRYPTO_HASH
	prompt "Crypto implementation to use for hash generation in BL0."
	default SB_CRYPTO_OBERON_SHA256

	config SB_CRYPTO_OBERON_SHA256
		bool "Software implementation of SHA256."
		select SB_NRF_OBERON

	config SB_CRYPTO_CC310_SHA256
		bool "Hardware implementation of SHA256" if HAS_HW_NRF_CC310
		select SB_NRF_CC310_BL
endchoice

endmenu
endif # SECURE_BOOT_CRYPTO
```

## subsys/bootloader/c_runtime_setup/Kconfig
```kconfig
choice
	prompt "C runtime setup selection"
	default SB_C_RUNTIME_SETUP_VARIANT_CUSTOM
	config SB_C_RUNTIME_SETUP_VARIANT_CUSTOM
		bool "Custom C runtime setup"
	config SB_C_RUNTIME_SETUP_VARIANT_ZEPHYR
		bool "Zephyr C runtime setup"
	config SB_C_RUNTIME_SETUP_VARIANT_MDK
		bool "MDK C runtime setup"
		select SB_VENDOR_SYSTEM_INIT(=y)
endchoice

config SB_VENDOR_SYSTEM_INIT
	bool "Boot with chip specific initialization"

config ADDITIONAL_LINKER_DIR
	default "$ZEPHYR_BASE/subsys/bootloader/scripts/arm/cortex_m"
	string "Additional linker script path"
	depends on SB_C_RUNTIME_SETUP_VARIANT_MDK
```
